## drivers/mmc/Kconfig
```kconfig
#
# MMC subsystem configuration
#

menuconfig MMC
	tristate "MMC/SD/SDIO card support"
	depends on HAS_IOMEM
	help
	  This selects MultiMediaCard, Secure Digital and Secure
	  Digital I/O support.

	  If you want MMC/SD/SDIO support, you should say Y here and
	  also to your specific host controller driver.

config SDCARD_PISSARRO
	bool "Enable SDCARD support"
	default n
	help
	  This adds support to SDCARD support to PISSARRO.

	  If you don't have PISSARRO it should off.
if MMC

source "drivers/mmc/core/Kconfig"

source "drivers/mmc/host/Kconfig"

endif # MMC
```
